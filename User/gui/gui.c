#include "bsp_ili9341_lcd.h"
#include "gui.h"

//==========================================================================
//初始化GUI
//==========================================================================
void GUI_Init(void)
{
	LCD_Init();
}
//==========================================================================
//选择是否使用横屏模式
//==========================================================================
void GUI_SetLand(bool LandMode)
{
	if(LandMode)
		LCD_LandModeOn();
	else
		LCD_LandModeOff();
}
//==========================================================================
//判断当前是否处在横屏模式
//==========================================================================
bool GUI_GetLandMode(void)
{
	return LCD_GetLandMode();
}
//==========================================================================
//选择是否使用Brg颜色模式
//==========================================================================
void GUI_SetBgr(bool UseBgr)
{
	if(UseBgr)
		LCD_BgrMode(TRUE);
	else
		LCD_BgrMode(FALSE);
}
//==========================================================================
//用一种颜色填充屏幕
//==========================================================================
void GUI_FillScreen(u16 Color)
{
	if(LCD_GetLandMode())
	{
		LCD_FillArea(0,0,320,240,Color);
	}
	else
	{
		LCD_FillArea(0,0,240,320,Color);
	}
}
//==========================================================================
//填充颜色，返回False表示绘画区域越界
//==========================================================================
bool GUI_Fill(u16 x,u16 y,u16 width,u16 hight,u16 Color)
{
	if(LCD_GetLandMode())
	{
		if(x+width>LCD_VMAX ||y+hight>LCD_HMAX || width==0 ||hight==0)
		{
			return FALSE;
		}
	}
	else
	{
		if(x+width>LCD_HMAX ||y+hight>LCD_VMAX || width==0 ||hight==0)
		{
			return FALSE;
		}
	}
			
	LCD_FillArea(x,y,width,hight,Color);
	return TRUE;
}

//==========================================================================
//读某点的颜色，用16位表示
//==========================================================================
u16 GUI_ReadBit16Point(u16 x,u16 y)
{
	return LCD_ReadPoint(x,y);
}
